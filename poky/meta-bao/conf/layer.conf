## poky/meta-bao/conf/layer.conf
```bitbake
BBPATH .= ":${LAYERDIR}"

BBFILES += "${LAYERDIR}/recipes-*/*/*.bb \
            ${LAYERDIR}/recipes-*/*/*.bbappend"

BBFILE_COLLECTIONS += "bao"
BBFILE_PATTERN_bao = "^${LAYERDIR}/"
BBFILE_PRIORITY_bao = "20"

LAYERSERIES_COMPAT_bao = "nabield scarthgap"
LAYERDEPENDS_bao = "core raspberrypi"
LAYERRECOMMENDS_bao = ""

LICENSE_PATH += "${LAYERDIR}/files/custome-licenses"


BBFILES += "${@' '.join('${LAYERDIR}/dynamic-layers/%s/recipes*/*/*.bbappend' % layer \
               for layer in BBFILE_COLLECTIONS.split())}"
BBFILES += "${@' '.join('${LAYERDIR}/dynamic-layers/%s/recipes*/*/*.bb' % layer \
               for layer in BBFILE_COLLECTIONS.split())}"

BBFILES_DYNAMIC += " \
    openembedded-layer:${LAYERDIR}/dynamic-layers/openembedded-layer/*/*/*.bb \
"
```
